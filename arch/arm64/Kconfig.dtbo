## arch/arm64/Kconfig.dtbo
```kconfig
config MACH_EXYNOS7885_A10_OPEN
	bool "Build DTBO image for Galaxy A10"
	depends on SOC_EXYNOS7885
	default n
	help
	Say Y here if you want to enable building dtbo for Galaxy A10.

config MACH_EXYNOS7885_A20_GLOBAL
	bool "Build DTBO image for Galaxy A20"
	depends on SOC_EXYNOS7885
	default n
	help
	Say Y here if you want to enable building dtbo for galaxy A20.

config MACH_EXYNOS7885_A20E_OPEN
	bool "Build DTBO image for Galaxy A20"
	depends on SOC_EXYNOS7885
	default n
	help
	Say Y here if you want to enable building dtbo for Galaxy A20e.

config MACH_EXYNOS7885_A30_OPEN
	bool "Build DTBO image for Galaxy A30"
	depends on SOC_EXYNOS7885
	default n
	help
	Say Y here if you want to enable building dtbo for Galaxy A30.

config MACH_EXYNOS7885_A30s_OPEN
	bool "Build DTBO image for Galaxy A30s"
	depends on SOC_EXYNOS7885
	default n
	help
	Say Y here if you want to enable building dtbo for Galaxy A30s.

config MACH_EXYNOS7885_A40_OPEN
	bool "Build DTBO image for Galaxy A40"
	depends on SOC_EXYNOS7885
	default n
	help
	Say Y here if you want to enable building dtbo for Galaxy A40.

config MACH_EXYNOS7885_M20_OPEN
	bool "Build DTBO image for Galaxy M20"
	depends on SOC_EXYNOS7885
	default n
	help
	Say Y here if you want to enable building dtbo for Galaxy M20.

config USE_STOCK_CONFIG_FOR_IKCONFIG
	bool "Use stock config for /proc/config.gz"
	depends on IKCONFIG
	default n
	help
	  Say Y here to use stock OEM unmodified defconfig for /proc/config.gz
```
